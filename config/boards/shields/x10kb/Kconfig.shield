## config/boards/shields/x10kb/Kconfig.shield
```kconfig
# Copyright (c) 2020 Pete Johanson
# SPDX-License-Identifier: MIT

config SHIELD_X10KB_LEFT
    def_bool $(shields_list_contains,x10kb_left)

config SHIELD_X10KB_RIGHT
    def_bool $(shields_list_contains,x10kb_right)
```
